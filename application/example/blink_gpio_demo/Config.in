## application/example/blink_gpio_demo/Config.in
```kconfig
config AOS_APP_BLINK_GPIO_DEMO
    bool "Blink GPIO Demo"
    select AOS_COMP_OSAL_AOS if !AOS_CREATE_PROJECT
    help
        blink gpio Demo

if AOS_APP_BLINK_GPIO_DEMO
# Configurations for app blink_demo
config SYSINFO_APP_VERSION
    string "Firmware Version"
    default "app-1.0.0-20200214.140831"
    help
        application main firmware version
endif
```

## application/example/helloiot/Config.in
```kconfig
config AOS_APP_HELLOIOT
    bool "HelloIot Demo"
    select AOS_COMP_OSAL_AOS if !AOS_CREATE_PROJECT
    help
        HelloIot demo

if AOS_APP_HELLOIOT
# Configurations for app HelloIot demo
config SYSINFO_APP_VERSION
    string "Firmware Version"
    default "app-1.0.0-20200214.140831"
    help
        application main firmware version
endif
```
